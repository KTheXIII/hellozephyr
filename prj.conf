## CMakeLists.txt
```
cmake_minimum_required(VERSION 3.20.0)

set(MAKE_EXPORT_COMPILE_COMMANDS ON)
set(CMAKE_CXX_STANDARD 17)
set(CMAKE_CXX_STANDARD_REQUIRED ON)

find_package(Zephyr REQUIRED HINTS "$ENV{ZEPHYR_BASE}")
project(hellozephyr VERSION 0.0.0)
target_sources(app PRIVATE src/main.cpp)
```

## prj.conf
```kconfig
CONFIG_CPLUSPLUS=y
CONFIG_LIB_CPLUSPLUS=y
CONFIG_NEWLIB_LIBC=y
```

## src/main.cpp
```c
#include <cstdint>

#include "zephyr.h"
#include "sys/printk.h"

auto main() -> std::int32_t {
    printk("Hello World! %s\n", CONFIG_BOARD);
    return 0;
}
```
